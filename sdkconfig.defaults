## sdkconfig.defaults
```kconfig
# --- 目标芯片 ---
CONFIG_IDF_TARGET="esp32c3"
# 注:ESP32-C3 无 PSRAM,故不设 CONFIG_SPIRAM。

# --- Flash ---
# FoloToy AI Passport 当前产品/固件基线使用 8MB Flash。
CONFIG_ESPTOOLPY_FLASHSIZE_8MB=y
# 固定 8MB 镜像头，关闭 detect，便于 idf.py merge-bin。
CONFIG_ESPTOOLPY_HEADER_FLASHSIZE_UPDATE=n
# 3 MB 应用上限与固定保护分区保持一致。分区表保留
# cardid@0x356000，二创不得移动或覆盖。
CONFIG_PARTITION_TABLE_CUSTOM=y
CONFIG_PARTITION_TABLE_CUSTOM_FILENAME="partitions.csv"
CONFIG_PARTITION_TABLE_FILENAME="partitions.csv"

# --- 控制台:USB-Serial-JTAG(C3 原生 USB,GPIO18/19)---
# 不用 UART0:其默认 TX=GPIO21 与本板背光引脚冲突。
CONFIG_ESP_CONSOLE_USB_SERIAL_JTAG=y
CONFIG_ESP_CONSOLE_SECONDARY_NONE=y

# --- LVGL ---
CONFIG_LV_COLOR_DEPTH_16=y
CONFIG_LV_FONT_MONTSERRAT_14=y
CONFIG_LV_FONT_MONTSERRAT_20=y
CONFIG_LV_MEM_SIZE_KILOBYTES=32

# --- 系统 ---
CONFIG_FREERTOS_HZ=1000

# --- Bluetooth LE / Bluedroid (官方 esp_hid 组件) ---
CONFIG_BT_ENABLED=y
CONFIG_BT_BLUEDROID_ENABLED=y
CONFIG_BT_BLE_ENABLED=y
CONFIG_BT_BLE_42_FEATURES_SUPPORTED=y
```
